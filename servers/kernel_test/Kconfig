## servers/minitest/Kconfig
```kconfig
menu "Minitest"
	depends on BOOTSTRAP_MINITEST

    config BOOTSTRAP
        string
        default "minitest"
endmenu
```

## servers/minlin/Kconfig
```kconfig
menuconfig MINLIN_SERVER
    bool "Linux ABI compatibility layer (experimental)"
    select ABI_EMU

if MINLIN_SERVER

config AUTOSTART_MINLIN
    bool "Start automatically on boot"
    default y

endif
```

## servers/nommu_test/Kconfig
```kconfig
menu "NOMMU test"
	depends on BOOT_TASK_NOMMU_TEST

    config BOOT_TASK
        string
        default "nommu_test"
endmenu
```

## servers/ps2kbd/Kconfig
```kconfig
menuconfig PS2KBD_SERVER
    bool "PS/2 keyboard driver"

if PS2KBD_SERVER

config AUTOSTART_PS2KBD
    bool "Start automatically on boot"
    default y

endif
```

## servers/ramdisk/Kconfig
```kconfig
menuconfig RAMDISK_SERVER
    bool "Ramdisk (ephemeral) storage device"

if RAMDISK_SERVER

config AUTOSTART_RAMDISK
    bool "Start automatically on boot"
    default y

endif
```

## servers/shell/Kconfig
```kconfig
menuconfig SHELL_SERVER
    bool "Shell"

if SHELL_SERVER

config AUTOSTART_SHELL
    bool "Start automatically on boot"
    default y

endif
```

## servers/tarfs/Kconfig
```kconfig
menuconfig TARFS_SERVER
    bool "Tarball (ephemeral) file system server"

if TARFS_SERVER

config AUTOSTART_TARFS
    bool "Start automatically on boot"
    default y

endif
```

## servers/tcpip/Kconfig
```kconfig
menuconfig TCPIP_SERVER
    bool "TCP/IP protocol stack"

if TCPIP_SERVER

config AUTOSTART_TCPIP
    bool "Start automatically on boot"
    default y

endif
```

## servers/virtio_blk/Kconfig
```kconfig
menuconfig VIRTIO_BLK_SERVER
    bool "Virtio-blk Device Driver (WIP)"
    select PCI_SERVER
    default n
```

## servers/vm/Kconfig
```kconfig
menu "vm"
	depends on BOOT_TASK_VM

    config BOOT_TASK
        string
        default "vm"
endmenu
```

## servers/webapi/Kconfig
```kconfig
menuconfig WEBAPI_SERVER
    bool "Web API server"

if WEBAPI_SERVER

config AUTOSTART_WEBAPI
    bool "Start automatically on boot"
    default n

endif
```
