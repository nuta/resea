## Kconfig
```kconfig
mainmenu "Resea Build Configuration"

choice
    prompt "Build mode"
    config BUILD_DEBUG
        bool "Debug"
    config BUILD_RELEASE
        bool "Release"
endchoice

source "$(BUILD_DIR)/Kconfig.autogen"

menu "Common Setup (kernel and userland)"
    choice
        prompt "Compiler optimization level"
        default OPT_LEVEL_2
        config OPT_LEVEL_0
            bool "-O0"
        config OPT_LEVEL_2
            bool "-O2"
        config OPT_LEVEL_3
            bool "-O3"
        config OPT_LEVEL_S
            bool "-Os"
    endchoice

    config NUM_SYMBOLS
        int "The (maximum) number of symbols"
        range 0 4096
        default 512
endmenu

source "kernel/Kconfig"
source "libs/resea/Kconfig"
```

## kernel/Kconfig
```kconfig
menu "Kernel"
    source "kernel/arch/x64/Kconfig"

    config SEMIHOSTING
        bool "Use semihosting features (e.g. QEMU)"
        default y

    config TRACE_IPC
        bool "Trace message passing"
        default n

    config IPC_FASTPATH
        bool "Enable IPC fastpath"
        default y

    config NOMMU
        bool "Disable virtual memory"
        default n
        depends on ARCH_ARM

    config NUM_TASKS
        int "The (maximum) number of tasks"
        range 1 512
        default 64

    config TASK_NAME_LEN
        int "The maximum length of a task name"
        range 4 64
        default 16

    config ONESHOT_HEAP_SIZE
        int "The size of oneshot heap in # of pages"
        default 4096
        depends on !NOMMU
        help
            This config specifies the size of statically allocated heap used
            for allocating pages for the init task. Increase the value if you
            got "run out of memory" panic on boot.

    config TASK_TIME_SLICE_MS
        int "The context switching time slice in milliseconds."
        range 5 200
        default 10

    config KLOG_BUF_SIZE
        int "The size of kernel log buffer."
        range 1 8192
        default 1024

    config ABI_EMU
        bool "Enable ABI emulation"
        default n
endmenu
```

## kernel/arch/arm/Kconfig
```kconfig
menu "ARM Options"
	depends on ARCH_ARM

    config ARCH
        string
    	default "arm"

    config ARCH_DEFAULTS
    	bool
	    default y
        select NOMMU
endmenu

source "kernel/arch/arm/machines/microbit/Kconfig"
```

## kernel/arch/arm/machines/microbit/Kconfig
```kconfig
if MACHINE_MICROBIT
menu "Micro:bit Machine Support"
	depends on ARCH_ARM

    config MACHINE
        string
        default "microbit"

endmenu
endif
```

## kernel/arch/arm64/Kconfig
```kconfig
menu "ARM64 Options"
	depends on ARCH_ARM64

    config TRACE_EXCEPTION
        bool "Trace exceptions (including system calls)"
        default n

endmenu

source "kernel/arch/arm64/machines/raspi3/Kconfig"
```

## kernel/arch/arm64/machines/raspi3/Kconfig
```kconfig
if MACHINE_RASPI3
menu "Raspberry Pi 3B+ Machine Support"
	depends on ARCH_ARM64

    config MACHINE
        string
        default "raspi3"

    config FORCE_REBOOT_BY_WATCHDOG
        bool "Enable watchdog timer to reboot the system periodically"
        default n
        help
            This feature is pretty useful for my baremetal testing environment
            on Raspberry Pi.

    config WATCHDOG_TIMEOUT
        int "The timeout value for the watchdog timer (in seconds)"
        depends on FORCE_REBOOT_BY_WATCHDOG
        range 1 10
        default 10

endmenu
endif
```

## kernel/arch/example/Kconfig
```kconfig
menu "Example Options"
	depends on ARCH_EXAMPLE

    config ARCH
        string "The architecture name"
        default "example"

    config ARCH_DEFAULTS
    	bool "Default confgurations for example arch."
	    default y
        # Add `select` below if needed.
        # select NOMMU
endmenu
```

## kernel/arch/x64/Kconfig
```kconfig
menu "x64 Options"
	depends on ARCH_X64

    config X64_PRINTK_IN_SCREEN
        bool "Printk in the screen"
        default y
endmenu
```

## libs/resea/Kconfig
```kconfig
menu "Userland"

config OOL_BUFFER_LEN
    int "The length of a ool buffer."
    range 0 32768
    default 16384

endmenu
```

## servers/Kconfig
```kconfig
config MODULES
    def_bool y
	option modules
	default y

menu "Servers"
    choice
        prompt "Initial task"
        config BOOT_TASK_VM
            bool "VM"
        config BOOT_TASK_NOMMU_TEST
            bool "Kernel test for a NOMMU CPU"
            depends on NOMMU
    endchoice

    menu "Enabled servers"
        comment "<*>: autostarted / <M>: manually started from shell"

        config SHELL_SERVER
            tristate "Shell"
        config DM_SERVER
            tristate "Device Management server"
        config TCPIP_SERVER
            tristate "TCP/IP server"
        config WEBAPI_SERVER
            tristate "Web API server"
        config MINLIN_SERVER
            tristate "Linux ABI Emulation Layer"
            select ABI_EMU

        menu "Applications"
            config HELLO_SERVER
                tristate "Hello World"
            config BENCHMARK_SERVER
                tristate "Benchmark"
            config UTILS_SERVER
                tristate "Command-line Utilities"
            config TEST_SERVER
                tristate "Kernel/Userland integrated tests"
        endmenu

        menu "Filesystem Drivers"
            config TARFS_SERVER
                tristate "Tarball (ephemeral) file system driver"
            config FATFS_SERVER
                tristate "FAT file system driver"
        endmenu

        menu "Device Drivers"
            config RAMDISK_SERVER
                tristate "RAM disk driver"
            config E1000_SERVER
                tristate "e1000 NIC driver"
                depends on DM_SERVER
            config VIRTIO_NET_SERVER
                tristate "virtio-net NIC driver"
                depends on DM_SERVER
        endmenu

        config HELLO_FROM_RUST_SERVER
                tristate "Hello World from Rust"
        config EXAMPLE_SERVER
            tristate "Example server (template)"
    endmenu

    source "servers/*/Kconfig"
endmenu
```

## servers/appmgr/Kconfig
```kconfig
menuconfig APPMGR_SERVER
    bool "App Management Server (appmgr)"
    default y
```

## servers/benchmark/Kconfig
```kconfig
menuconfig BENCHMARK_SERVER
    bool "Run Micro-benchmarks"

if BENCHMARK_SERVER

config AUTOSTART_BENCHMARK
    bool "Start automatically on boot"
    default n

endif
```

## servers/benchmark_client/Kconfig
```kconfig
menuconfig BENCHMARK_CLIENT_SERVER
    bool "Benchmark Client"
    select BENCHMARK_SERVER_SERVER
    default n
```

## servers/bootstrap/Kconfig
```kconfig
menu "Bootstrap"
	depends on BOOTSTRAP_BOOTSTRAP

    config BOOTSTRAP
        string
        default "bootstrap"
endmenu
```

## servers/display/Kconfig
```kconfig
menuconfig DISPLAY_SERVER
    bool "Text-based display driver"
    depends on ARCH_X64

if DISPLAY_SERVER

config AUTOSTART_DISPLAY
    bool "Start automatically on boot"
    default y

endif
```

## servers/drivers/gpu/virtio_gpu/Kconfig
```kconfig
menu "virtio-gpu"
	depends on VIRTIO_GPU_SERVER

    config VIRTIO_GPU_DEMO
        bool "Render image patterns to demonstrate virtio-gpu"
endmenu
```

## servers/e1000/Kconfig
```kconfig
menuconfig E1000_SERVER
    bool "e1000 network card driver"

if E1000_SERVER

config AUTOSTART_E1000
    bool "Start automatically on boot"
    default y

endif
```

## servers/fatfs/Kconfig
```kconfig
menuconfig FATFS_SERVER
    bool "FAT file system driver"

if FATFS_SERVER

config AUTOSTART_FATFS
    bool "Start automatically on boot"
    default y

endif
```

## servers/hello/Kconfig
```kconfig
menu "Hello World"
	depends on HELLO_SERVER

    config PRINT_PERIODICALLY
        bool "Print a message every second"
endmenu
```
